## Kconfig
```kconfig
# Custom component config
menu "esp-button"
    config BUTTON_DEBOUNCE_MS
        int "Debounce interval (ms)"
        default 50
        help
            In certain configs (including default), event might be also delayed by this value.

    config BUTTON_LONG_PRESS_ENABLE
        bool "Long-press support"
        default y
        help
            Disable to remove long-press logic completely, saving few bytes.

    config BUTTON_ISR_IN_IRAM
        bool "ISR in IRAM"
        default n
        help
            Place interrupt handlers in IRAM.
endmenu
```

## example/main/Kconfig.projbuild
```kconfig
menu "Example config"
    config EXAMPLE_BUTTON_PIN
        int "Test button PIN"
        default 0
        help
            Button 0 is often on dev board for boot mode selection.

    config EXAMPLE_BUTTON_LEVEL
        int  "Test button pressed level"
        default 0
        help
            0 for low-on-push, 1 for high-on-push.

    config EXAMPLE_BUTTON_INTERNAL_PULL
        bool "Test button internal pull-up/down"
        default n # Not needed for GPIO0

    config EXAMPLE_BUTTON_LONG_PRESS_MS
        int "Test button long-press interval"
        default 3000

    config EXAMPLE_BUTTON_CONTINUOUS_CALLBACK
        bool "Test button fire press events continuously"
        default n
endmenu
```
